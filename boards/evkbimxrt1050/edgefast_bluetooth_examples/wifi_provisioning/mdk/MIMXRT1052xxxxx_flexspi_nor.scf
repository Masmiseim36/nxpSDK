#!armclang --target=arm-arm-none-eabi -mcpu=cortex-m7 -E -x c
/*
** ###################################################################
**     Processors:          MIMXRT1052CVJ5B
**                          MIMXRT1052CVL5B
**                          MIMXRT1052DVJ6B
**                          MIMXRT1052DVL6B
**
**     Compiler:            Keil ARM C/C++ Compiler
**     Reference manual:    IMXRT1050RM Rev.2.1, 12/2018 | IMXRT1050SRM Rev.2
**     Version:             rev. 1.0, 2018-09-21
**     Build:               b210709
**
**     Abstract:
**         Linker file for the Keil ARM C/C++ Compiler
**
**     Copyright 2016 Freescale Semiconductor, Inc.
**     Copyright 2016-2021 NXP
**     All rights reserved.
**
**     SPDX-License-Identifier: BSD-3-Clause
**
**     http:                 www.nxp.com
**     mail:                 support@nxp.com
**
** ###################################################################
*/

/* NVM */
/* By default, the NVM is not used. */
#if !(defined(gUseNVMLink_d))
    #define gUseNVMLink_d              0
#endif

#if !(defined(gEraseNVMLink_d))
    #define gEraseNVMLink_d            0
#endif

#if !(defined(gNVMSectorCountLink_d))
    #define gNVMSectorCountLink_d      4
#endif

#if (defined(__ram_vector_table__))
  #define __ram_vector_table_size__    0x00000400
#else
  #define __ram_vector_table_size__    0x00000000
#endif

#define m_flash_config_start           0x60000000
#define m_flash_config_size            0x00001000

#define m_ivt_start                    0x60001000
#define m_ivt_size                     0x00001000

#define m_interrupts_start             0x60002000
#define m_interrupts_size              0x00000400

#define m_text_start                   0x60002400
#define _ROM_END_                      0x63AFFFFF
#define m_qacode_start                 0x00000000
#define m_qacode_size                  0x00020000

#define m_interrupts_ram_start         0x20000000
#define m_interrupts_ram_size          __ram_vector_table_size__

#define NVM_ADAPTER_TABLE_SIZE         0x200
#define NVM_TABLE_SIZE                 0x1000
#define NVM_TABLE_START                m_interrupts_ram_start + m_interrupts_ram_size

#define m_data_start                   (m_interrupts_ram_start + m_interrupts_ram_size + NVM_TABLE_SIZE)
#define m_data_size                    (0x00020000 - m_interrupts_ram_size - NVM_TABLE_SIZE)

#define m_data2_start                  0x20200000
#define m_data2_size                   0x00040000
#define STORAGE_AREA_LENGTH            0x10000

#define STORAGE_AREA_SIZE             STORAGE_AREA_LENGTH
#define STORAGE_AREA_START            (_ROM_END_ - STORAGE_AREA_SIZE + 1)
#define m_text_size                   (_ROM_END_ - m_text_start - STORAGE_AREA_SIZE - NVM_ADAPTER_TABLE_SIZE + 1)

/*** NVM Configuration Start ***/
#if (defined(gUseNVMLink_d))
  #define NVM_AREA_START              STORAGE_AREA_START
  
  /* 4k flash sector size */
  #define NV_STORAGE_SECTOR_SIZE      0x1000
  #define NV_STORAGE_MAX_SECTORS      gNVMSectorCountLink_d
  #define NVM_AREA_SIZE               (NV_STORAGE_SECTOR_SIZE * NV_STORAGE_MAX_SECTORS)

  #define NV_STORAGE_END_ADDRESS      (NVM_AREA_START + NVM_AREA_SIZE - 1)
  #define NV_STORAGE_START_ADDRESS    (NVM_AREA_START)
#endif
/*** NVM Configuration End ***/

/*** littleFS configuration Start ***/
#define EDGEFAST_BT_LITTLEFS_STORAGE_START_ADDRESS  (_ROM_END_ + 1)
#define EDGEFAST_BT_LITTLEFS_STORAGE_END_ADDRESS  (0x63D80000 )
#define EDGEFAST_BT_LITTLEFS_STORAGE_SECTOR_SIZE    (0x40000) 
#define EDGEFAST_BT_LITTLEFS_STORAGE_MAX_SECTORS    ((EDGEFAST_BT_LITTLEFS_STORAGE_END_ADDRESS - EDGEFAST_BT_LITTLEFS_STORAGE_START_ADDRESS) / EDGEFAST_BT_LITTLEFS_STORAGE_SECTOR_SIZE)
/*** littleFS configuration End ***/

/* Sizes */
#if (defined(__stack_size__))
  #define Stack_Size                   __stack_size__
#else
  #define Stack_Size                   0x0400
#endif

#if (defined(__heap_size__))
  #define Heap_Size                    __heap_size__
#else
  #define Heap_Size                    0x1000
#endif

#if defined(XIP_BOOT_HEADER_ENABLE) && (XIP_BOOT_HEADER_ENABLE == 1)
LR_m_text m_flash_config_start m_text_start+m_text_size-m_flash_config_start {   ; load region size_region
  RW_m_config_text m_flash_config_start FIXED m_flash_config_size { ; load address = execution address
    * (.boot_hdr.conf, +FIRST)
  }

  RW_m_ivt_text m_ivt_start FIXED m_ivt_size { ; load address = execution address
    * (.boot_hdr.ivt, +FIRST)
    * (.boot_hdr.boot_data)
    * (.boot_hdr.dcd_data)
  }
#else
LR_m_text m_interrupts_start m_text_start+m_text_size-m_interrupts_start {   ; load region size_region
#endif
  VECTOR_ROM m_interrupts_start FIXED m_interrupts_size { ; load address = execution address
    * (.isr_vector,+FIRST)
  }
  ER_m_text m_text_start FIXED m_text_size { ; load address = execution address
    * (InRoot$$Sections)
    .ANY (+RO)
  }

  ER_bt_conn_cb +0 { ;
    * (._bt_conn_cb*)
  }

  ER_bt_gatt_service_static +0 { ;
    * (._bt_gatt_service_static*)
  }

  ER_settings_handler_static +0 { ;
    * (._settings_handler_static*)
  }

  ER_bt_l2cap_fixed_chan +0 { ;
    * (._bt_l2cap_fixed_chan*)
  }

  ER_bt_l2cap_br_fixed_chan +0 { ;
    * (._bt_l2cap_br_fixed_chan*)
  }

  ER_NVM_ADAPTER_TABLE m_text_start+m_text_size UNINIT NVM_ADAPTER_TABLE_SIZE { ; load address = execution address
    * (*NVM_ADAPTER_TABLE)
  }

  NVM_region NV_STORAGE_START_ADDRESS EMPTY NVM_AREA_SIZE { ; load address = execution address
  }

  EDGEFAST_BT_LittleFS_region EDGEFAST_BT_LITTLEFS_STORAGE_START_ADDRESS EMPTY (EDGEFAST_BT_LITTLEFS_STORAGE_END_ADDRESS - EDGEFAST_BT_LITTLEFS_STORAGE_START_ADDRESS) { ; load address = execution address
  }
#if (defined(__ram_vector_table__))
  VECTOR_RAM m_interrupts_ram_start EMPTY m_interrupts_ram_size {
  }
#else
  VECTOR_RAM m_interrupts_start EMPTY 0 {
  }
#endif
  RW_NVM_TABLE NVM_TABLE_START UNINIT NVM_TABLE_SIZE { ; RW data
    * (*NVM_TABLE)
  }
  RW_m_data m_data2_start m_data2_size { ; RW data
    .ANY (+RW +ZI)
    * (RamFunction)
    /* Necessary to run flash routines from SRAM */
    fsl_adapter_flexspi_hyper_nor_flash.o (+RO +RW +ZI)
    fsl_adapter_flexspi_hyper_flash_config.o  (+RO +RW +ZI)
    fsl_clock.o (+RO +RW +ZI)
    fsl_flexspi.o (+RO +RW +ZI)
    NV_Flash.o (+RO +RW +ZI)
    mflash_drv.o (+RO +RW +ZI)
    * (NonCacheable.init)
    * (*NonCacheable)
    * (DataQuickAccess)
  }

  RW_net_buf_pool +0 { ;
    * (._net_buf_pool*)
  }

  RW_m_ram_text m_qacode_start m_qacode_size { ;
    * (CodeQuickAccess)
  }
  RW_m_ncache m_data_start {
  write_task_pl.o (+RW +ZI)
  aws_demo.o (+RW +ZI)
  memp.o (+RW +ZI)
  mem.o (+RW +ZI)
  ht_read_task_pl.o (+RW +ZI)
  write_task_pl.o (+RW +ZI)
  sdio.o (+RW +ZI) 
  wifi-mem.o (+RW +ZI)
  wifi-sdio.o (+RW +ZI)
  wifi-sdio.o (+RW +ZI)
  mlan_init.o (+RW +ZI)
  mlan_sdio.o (+RW +ZI)
  l2cap_init.o (+RW +ZI)
  BT_storage_pl.o (+RW +ZI)
  fsl_debug_console.o (+RW +ZI)
/*  gatt.o (+RW +ZI)*/ 
  controller_wifi_nxp.o (+RW +ZI)
  core_pkcs11_mbedtls.o (+RW +ZI)
  aws_iot_demo_shadow.o (+RW +ZI)
  iot_ble_hal_gatt_server.o (+RW +ZI)
  wlan.o (+RW +ZI)
  iot_wifi.o (+RW +ZI)
  wlan_txpwrlimit_cfg.o (+RW +ZI)
  ht_core.o (+RW +ZI)
  l2cap_fixed_channel.o (+RW +ZI)
  smp_init.o (+RW +ZI)
  write_task.o (+RW +ZI)
  mlan_cfp.o (+RW +ZI)
  appl_gatt_server.o (+RW +ZI)
  iot_ble_hal_common_gap.o (+RW +ZI)
  iot_ble_hal_gap.o (+RW +ZI)
  iot_ble_hal_gatt_server.o (+RW +ZI)
  mlan_11d.o (+RW +ZI)
  mlan_glue.o (+RW +ZI)
  hci_init.o (+RW +ZI)
  iot_ble_data_transfer.o (+RW +ZI)
  iot_ble_wifi_provisioning.o (+RW +ZI)
  mbedtls_error.o (+RW +ZI)
  iot_ble_gap.o (+RW +ZI)
  
  }
  RW_m_ncache_unused +0 EMPTY m_data_size-ImageLength(RW_m_ncache)-Stack_Size-Heap_Size { ; Empty region added for MPU configuration
  }

  ARM_LIB_HEAP +0 EMPTY Heap_Size {    ; Heap region growing up
  }

  ARM_LIB_STACK m_data_start+m_data_size EMPTY -Stack_Size { ; Stack region growing down
  }

}
