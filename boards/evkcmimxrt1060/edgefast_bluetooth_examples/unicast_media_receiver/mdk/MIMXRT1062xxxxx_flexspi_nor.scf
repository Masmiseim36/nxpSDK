#!armclang --target=arm-arm-none-eabi -mcpu=cortex-m7 -E -x c
/*
** ###################################################################
**     Processors:          MIMXRT1062CVJ5A
**                          MIMXRT1062CVJ5B
**                          MIMXRT1062CVL5A
**                          MIMXRT1062CVL5B
**                          MIMXRT1062DVJ6A
**                          MIMXRT1062DVJ6B
**                          MIMXRT1062DVL6A
**                          MIMXRT1062DVL6B
**                          MIMXRT1062DVN6B
**                          MIMXRT1062XVN5B
**
**     Compiler:            Keil ARM C/C++ Compiler
**     Reference manual:    IMXRT1060RM Rev.3, 07/2021 | IMXRT106XSRM Rev.0
**     Version:             rev. 0.2, 2022-03-25
**     Build:               b221009
**
**     Abstract:
**         Linker file for the Keil ARM C/C++ Compiler
**
**     Copyright 2016 Freescale Semiconductor, Inc.
**     Copyright 2016-2023 NXP
**     All rights reserved.
**
**     SPDX-License-Identifier: BSD-3-Clause
**
**     http:                 www.nxp.com
**     mail:                 support@nxp.com
**
** ###################################################################
*/

#if (defined(__ram_vector_table__))
  #define __ram_vector_table_size__    0x00000400
#else
  #define __ram_vector_table_size__    0x00000000
#endif

#define LITTLEFS_REGION_SIZE           0x00200000

#define m_flash_config_start           0x60000000
#define m_flash_config_size            0x00001000

#define m_ivt_start                    0x60001000
#define m_ivt_size                     0x00001000

#define m_interrupts_start             0x60002000
#define m_interrupts_size              0x00000400

#define m_text_start                   0x60002400
#define m_text_size                    0x007FDC00 - LITTLEFS_REGION_SIZE

#define m_qacode_start                 0x00000000
#define m_qacode_size                  0x00020000

#define m_interrupts_ram_start         0x20000000
#define m_interrupts_ram_size          __ram_vector_table_size__

#define m_data_start                   (m_interrupts_ram_start + m_interrupts_ram_size)
#define m_data_size                    (0x00020000 - m_interrupts_ram_size)

#define m_data2_start                  0x20200000
#define m_data2_size                   0x000C0000

/* NOTE: The last LITTLEFS_REGION_SIZE Flash( in range (m_text_start + m_text_size) ~ (m_text_start + m_text_size + LITTLEFS_REGION_SIZE -1)) is reserved for litteFS data */

/*** littleFS configuration Start ***/
#define EDGEFAST_BT_LITTLEFS_STORAGE_START_ADDRESS  (m_text_start + m_text_size)
#define EDGEFAST_BT_LITTLEFS_STORAGE_SECTOR_SIZE    (0x1000)    /* 4k flash sector size */
#define EDGEFAST_BT_LITTLEFS_STORAGE_MAX_SECTORS    (LITTLEFS_REGION_SIZE / EDGEFAST_BT_LITTLEFS_STORAGE_SECTOR_SIZE)
/*** littleFS configuration End ***/

/* Sizes */
#if (defined(__stack_size__))
  #define Stack_Size                   __stack_size__
#else
  #define Stack_Size                   0x0400
#endif

#if (defined(__heap_size__))
  #define Heap_Size                    __heap_size__
#else
  #define Heap_Size                    0x1000
#endif

#if defined(XIP_BOOT_HEADER_ENABLE) && (XIP_BOOT_HEADER_ENABLE == 1)
LR_m_text m_flash_config_start m_text_start+m_text_size-m_flash_config_start {   ; load region size_region
  RW_m_config_text m_flash_config_start FIXED m_flash_config_size { ; load address = execution address
    * (.boot_hdr.conf, +FIRST)
  }

  RW_m_ivt_text m_ivt_start FIXED m_ivt_size { ; load address = execution address
    * (.boot_hdr.ivt, +FIRST)
    * (.boot_hdr.boot_data)
    * (.boot_hdr.dcd_data)
  }
#else
LR_m_text m_interrupts_start m_text_start+m_text_size-m_interrupts_start {   ; load region size_region
#endif
  VECTOR_ROM m_interrupts_start FIXED m_interrupts_size { ; load address = execution address
    * (.isr_vector,+FIRST)
  }
  ER_m_text m_text_start FIXED m_text_size { ; load address = execution address
    * (InRoot$$Sections)
    .ANY (+RO)
  }

  ER_bt_conn_cb +0 { ;
    * (._bt_conn_cb*)
  }

  ER_bt_ias_cb +0 { ;
    * (._bt_ias_cb*)
  }

  ER_bt_gatt_service_static +0 { ;
    * (._bt_gatt_service_static*)
  }

  ER_settings_handler_static +0 { ;
    * (._settings_handler_static*)
  }

  ER_bt_l2cap_fixed_chan +0 { ;
    * (._bt_l2cap_fixed_chan*)
  }

  ER_bt_l2cap_br_fixed_chan +0 { ;
    * (._bt_l2cap_br_fixed_chan*)
  }

  EDGEFAST_BT_LittleFS_region EDGEFAST_BT_LITTLEFS_STORAGE_START_ADDRESS EMPTY (LITTLEFS_REGION_SIZE) { ; load address = execution address
  }

#if (defined(__ram_vector_table__))
  VECTOR_RAM m_interrupts_ram_start EMPTY m_interrupts_ram_size {
  }
#else
  VECTOR_RAM m_interrupts_start EMPTY 0 {
  }
#endif
  RW_m_data m_data2_start m_data2_size { ; RW data
    .ANY (+RW +ZI)
    * (RamFunction)
    /* Necessary to run flash routines from SRAM */
    fsl_adapter_flexspi_nor_flash.o (+RO +RW +ZI)
    fsl_flexspi.o (+RO +RW +ZI)
    mflash_drv.o (+RO +RW +ZI)

    srCvtFrm.o (+RO +RW +ZI)

    lc3_encoder_api.o (+RO +RW +ZI)
    lc3_encode.o (+RO +RW +ZI)
    lc3_decoder_api.o (+RO +RW +ZI)
    lc3_decode.o (+RO +RW +ZI)
    lc3_common.o (+RO +RW +ZI)
    lc3_fft.o (+RO +RW +ZI)
    lc3_init.o (+RO +RW +ZI)
    lc3_math_util.o (+RO +RW +ZI)
    lc3_tables.o (+RO +RW +ZI)
  }
  RW_m_usb_data +0 ALIGNALL 32 { ; USB RW data
    * (*CacheLineData.init)
    * (*CacheLineData)
  }
  ; Other regions shall not be placed between RW_m_usb_data and RW_m_usb_data_aux
  RW_m_usb_data_aux +0 ALIGN 32 EMPTY 0 { ; Empty region added for cache line alignment.
  }
  ARM_LIB_HEAP +0 EMPTY Heap_Size {    ; Heap region growing up
  }
  ARM_LIB_STACK m_data_start+m_data_size EMPTY -Stack_Size { ; Stack region growing down
  }
  RW_m_ram_text m_qacode_start m_qacode_size { ;
    * (CodeQuickAccess)
  }
  RW_m_data3 m_data_start m_data2_size { ;
    * (DataQuickAccess)
  }
  RW_m_ncache m_data_start EMPTY 0 { ; RW data
  }
  RW_m_ncache_unused +0 EMPTY 0 { ; Empty region added for MPU configuration
  }
  RW_m_data2 +0 m_data_size-Stack_Size-Heap_Size-ImageLength(RW_m_ncache)-ImageLength(RW_m_ncache_unused) {
    * (NonCacheable.init)
    * (*NonCacheable)
  }
  RW_net_buf_pool +0 { ;
    * (._net_buf_pool*)
  }

  RW_k_mem_slab +0 { ;
    * (._k_mem_slab*)
  }
}
