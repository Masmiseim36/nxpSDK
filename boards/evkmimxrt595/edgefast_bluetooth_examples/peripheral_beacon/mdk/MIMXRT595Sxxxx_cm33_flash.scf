#!armclang --target=arm-arm-none-eabi -march=armv8-m.main -E -x c
/*
** ###################################################################
**     Processors:          MIMXRT595SFAWC_cm33
**                          MIMXRT595SFFOC_cm33
**
**     Compiler:            Keil ARM C/C++ Compiler
**     Reference manual:    iMXRT500RM Rev.0, 01/2021
**     Version:             rev. 4.0, 2020-05-12
**     Build:               b210303
**
**     Abstract:
**         Linker file for the Keil ARM C/C++ Compiler
**
**     Copyright 2016 Freescale Semiconductor, Inc.
**     Copyright 2016-2021 NXP
**     All rights reserved.
**
**     SPDX-License-Identifier: BSD-3-Clause
**
**     http:                 www.nxp.com
**     mail:                 support@nxp.com
**
** ###################################################################
*/

/* NVM */
/* By default, the NVM is not used. */
#if !(defined(gUseNVMLink_d))
    #define gUseNVMLink_d              0
#endif

#if !(defined(gEraseNVMLink_d))
    #define gEraseNVMLink_d            0
#endif

#if !(defined(gNVMSectorCountLink_d))
    #define gNVMSectorCountLink_d      4
#endif


/* USB BDT size */
#define usb_bdt_size                   0x0
/* Sizes */
#if (defined(__stack_size__))
  #define Stack_Size                   __stack_size__
#else
  #define Stack_Size                   0x0400
#endif

#if (defined(__heap_size__))
  #define Heap_Size                    __heap_size__
#else
  #define Heap_Size                    0x1000
#endif

/* The SRAM region [0x10000-0x1BFFF] is reserved for ROM code. */
/* The SRAM region [0x0-0xFFFF], [0x1C000-0x1FFFF] are reserved for app-specific use cases. */
/* The SRAM region [0x20000-0x7FFFF] is reserved for Non-cached shared memory between M33 and DSP. */

#if (defined(__ram_vector_table__))
  #define __ram_vector_table_size__    0x00000200
#else
  #define __ram_vector_table_size__    0x00000000
#endif

#define  m_interrupts_start            0x08001000
#define  m_interrupts_size             0x00000200

#define  m_text_start                  0x08001200
#define _ROM_END_                      0x0B7FFFFF

#define m_interrupts_ram_start         0x20080000
#define m_interrupts_ram_size          __ram_vector_table_size__

#define NVM_ADAPTER_TABLE_SIZE         0x200
#define NVM_TABLE_SIZE                 0x1000
#define NVM_TABLE_START                m_interrupts_ram_start + m_interrupts_ram_size

#define m_data_start                   (m_interrupts_ram_start + m_interrupts_ram_size + NVM_TABLE_SIZE)
#define m_data_size                    (0x00280000 - m_interrupts_ram_size - NVM_TABLE_SIZE)

#define  m_usb_sram_start              0x40140000
#define  m_usb_sram_size               0x00004000

#define  m_boot_flash_conf_start       0x08000400

#define STORAGE_AREA_LENGTH            0x10000

#define STORAGE_AREA_SIZE             STORAGE_AREA_LENGTH
#define STORAGE_AREA_START            (_ROM_END_ - STORAGE_AREA_SIZE + 1)
#define m_text_size                   (_ROM_END_ - m_text_start - STORAGE_AREA_SIZE - NVM_ADAPTER_TABLE_SIZE + 1)

/*** NVM Configuration Start ***/
#if (defined(gUseNVMLink_d))
  #define NVM_AREA_START              STORAGE_AREA_START
  
  /* 4k flash sector size */
  #define NV_STORAGE_SECTOR_SIZE      0x1000
  #define NV_STORAGE_MAX_SECTORS      gNVMSectorCountLink_d
  #define NVM_AREA_SIZE               (NV_STORAGE_SECTOR_SIZE * NV_STORAGE_MAX_SECTORS)

  #define NV_STORAGE_END_ADDRESS      (NVM_AREA_START + NVM_AREA_SIZE - 1)
  #define NV_STORAGE_START_ADDRESS    (NVM_AREA_START)
#endif
/*** NVM Configuration End ***/

/*** littleFS configuration Start ***/
#define EDGEFAST_BT_LITTLEFS_STORAGE_START_ADDRESS  (_ROM_END_ + 1)
#define EDGEFAST_BT_LITTLEFS_STORAGE_END_ADDRESS    (0x0BFFFFFF + 1)
#define EDGEFAST_BT_LITTLEFS_STORAGE_SECTOR_SIZE    (0x1000)
#define EDGEFAST_BT_LITTLEFS_STORAGE_MAX_SECTORS    ((EDGEFAST_BT_LITTLEFS_STORAGE_END_ADDRESS - EDGEFAST_BT_LITTLEFS_STORAGE_START_ADDRESS) / EDGEFAST_BT_LITTLEFS_STORAGE_SECTOR_SIZE)
/*** littleFS configuration End ***/

LR_m_flash_conf m_boot_flash_conf_start m_interrupts_start-m_boot_flash_conf_start {
  FLASH_CONFIG m_boot_flash_conf_start m_interrupts_start-m_boot_flash_conf_start{ ; load address = execution address
    * (.flash_conf)
  }
}

LR_m_interrupts m_interrupts_start m_text_start+m_text_size-m_interrupts_start {
  VECTOR_ROM m_interrupts_start FIXED m_interrupts_size { ; load address = execution address
    * (.isr_vector,+FIRST)
  }

  ER_m_text m_text_start FIXED m_text_size { ; load address = execution address
    * (InRoot$$Sections)
    .ANY (+RO)
  }

  ER_bt_conn_cb +0 { ;
    * (._bt_conn_cb*)
  }

  ER_bt_gatt_service_static +0 { ;
    * (._bt_gatt_service_static*)
  }

  ER_settings_handler_static +0 { ;
    * (._settings_handler_static*)
  }

  ER_bt_l2cap_fixed_chan +0 { ;
    * (._bt_l2cap_fixed_chan*)
  }

  ER_bt_l2cap_br_fixed_chan +0 { ;
    * (._bt_l2cap_br_fixed_chan*)
  }

  ER_NVM_ADAPTER_TABLE m_text_start+m_text_size UNINIT NVM_ADAPTER_TABLE_SIZE { ; load address = execution address
    * (*NVM_ADAPTER_TABLE)
  }

  NVM_region NV_STORAGE_START_ADDRESS EMPTY NVM_AREA_SIZE { ; load address = execution address
  }

  EDGEFAST_BT_LittleFS_region EDGEFAST_BT_LITTLEFS_STORAGE_START_ADDRESS EMPTY (EDGEFAST_BT_LITTLEFS_STORAGE_END_ADDRESS - EDGEFAST_BT_LITTLEFS_STORAGE_START_ADDRESS) { ; load address = execution address
  }

#if (defined(__ram_vector_table__))
  VECTOR_RAM m_interrupts_ram_start EMPTY m_interrupts_ram_size {
  }
#else
  VECTOR_RAM m_interrupts_start EMPTY 0 {
  }
#endif

  RW_NVM_TABLE NVM_TABLE_START UNINIT NVM_TABLE_SIZE { ; RW data
    * (*NVM_TABLE)
  }

  RW_m_data m_data_start ALIGN 4 m_data_size-Stack_Size-Heap_Size { ; RW data
    * (CodeQuickAccess)
    * (DataQuickAccess)
    .ANY (+RW +ZI)
    * (RamFunction)
    /* Necessary to run flash routines from SRAM */
    fsl_adapter_flexspi_nor_flash.o (+RO +RW +ZI)
    fsl_flexspi.o (+RO +RW +ZI)
    NV_Flash.o (+RO +RW +ZI)
    mflash_drv.o (+RO +RW +ZI)
    * (NonCacheable.init)
    * (*NonCacheable)
  }

  RW_net_buf_pool +0 { ;
    * (._net_buf_pool*)
  }

  ARM_LIB_HEAP +0 EMPTY Heap_Size {    ; Heap region growing up
  }
  ARM_LIB_STACK m_data_start+m_data_size EMPTY -Stack_Size { ; Stack region growing down
  }

  ER_m_usb_bdt m_usb_sram_start UNINIT usb_bdt_size {
    * (*m_usb_bdt)
  }

  ER_m_usb_ram (m_usb_sram_start + usb_bdt_size) UNINIT (m_usb_sram_size - usb_bdt_size) {
    * (*m_usb_global)
  }
}
