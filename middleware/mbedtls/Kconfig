## middleware/mbedtls3x/Kconfig
```kconfig
menu "Mbed TLS 3.x"
    config MCUX_COMPONENT_middleware.mbedtls3x.crypto.no_psa
        bool "Crypto (No PSA)"

    config MCUX_COMPONENT_middleware.mbedtls3x.crypto
        bool "Crypto"
        select MCUX_COMPONENT_middleware.mbedtls3x.crypto.no_psa

    config MCUX_COMPONENT_middleware.mbedtls3x.x509
        bool "X.509"

    config MCUX_COMPONENT_middleware.mbedtls3x.p256m
        bool "p256-m"

    config MCUX_COMPONENT_middleware.mbedtls3x.ssl.no_psa
        bool "SSL (No PSA)"
        select MCUX_COMPONENT_middleware.mbedtls3x.crypto.no_psa
        select MCUX_COMPONENT_middleware.mbedtls3x.x509

    config MCUX_COMPONENT_middleware.mbedtls3x.ssl
        bool "SSL"
        select MCUX_COMPONENT_middleware.mbedtls3x.ssl.no_psa
        select MCUX_COMPONENT_middleware.mbedtls3x.crypto
        select MCUX_COMPONENT_middleware.mbedtls3x.x509

    config MCUX_COMPONENT_middleware.mbedtls3x.no_psa
        bool "Mbed TLS (No PSA)"
        select MCUX_COMPONENT_middleware.mbedtls3x.template
        select MCUX_COMPONENT_middleware.mbedtls3x.crypto.no_psa
        select MCUX_COMPONENT_middleware.mbedtls3x.ssl.no_psa
        select MCUX_COMPONENT_middleware.mbedtls3x.x509

    config MCUX_COMPONENT_middleware.mbedtls3x
        bool "Mbed TLS"
        select MCUX_COMPONENT_middleware.mbedtls3x.template
        select MCUX_COMPONENT_middleware.mbedtls3x.crypto
        select MCUX_COMPONENT_middleware.mbedtls3x.ssl
        select MCUX_COMPONENT_middleware.mbedtls3x.x509

    config MCUX_COMPONENT_middleware.mbedtls3x.tests
        bool "Tests"

    config MCUX_PRJSEG_middleware.mbedtls3x.default_heap_stack
        bool "Default Heap/Stack Configuration"

    config MCUX_COMPONENT_middleware.mbedtls3x.template
        bool "Template"

    menu "MCUX SDK Port"
        config MCUX_COMPONENT_middleware.mbedtls3x.port.config
            bool "Mbed TLS configuration header files"

        config MCUX_COMPONENT_middleware.mbedtls3x.port.psa_crypto_config
            bool "PSA configuration header files"

        config MCUX_COMPONENT_middleware.mbedtls3x.port.only_accelerator_config
            bool "Accelerator only configuration"

        config MCUX_COMPONENT_middleware.mbedtls3x.port.hw_init
            bool "Hardware initialization"

        config MCUX_COMPONENT_middleware.mbedtls3x.port.only_entropy
            bool "Only Entropy sources"

        config MCUX_COMPONENT_middleware.mbedtls3x.port.rng
            bool "Random Number Generator"
            select MCUX_COMPONENT_middleware.mbedtls3x
            select MCUX_COMPONENT_middleware.mbedtls3x.port.config
            if MCUX_COMPONENT_middleware.mbedtls3x.port.rng
                choice
                    prompt "RNG Implementation"
                    default MCUX_DEPENDENCY_COMPONENT_middleware.mbedtls3x.port.rng_DEPEND_ANYOF_1_OPTION_1
                    config MCUX_DEPENDENCY_COMPONENT_middleware.mbedtls3x.port.rng_DEPEND_ANYOF_1_OPTION_1
                        bool "RNG for LPC55S16"
                        select MCUX_COMPONENT_driver.rng_1
                        select MCUX_COMPONENT_middleware.mbedtls3x.port.hw_init
                        depends on MCUX_HW_DEVICE_LPC55S16
                    config MCUX_DEPENDENCY_COMPONENT_middleware.mbedtls3x.port.rng_DEPEND_ANYOF_1_OPTION_2
                        bool "TRNG for MIMXRT685S/RW610/RW612"
                        select MCUX_COMPONENT_driver.trng
                        select MCUX_COMPONENT_middleware.mbedtls3x.port.hw_init
                        depends on MCUX_HW_DEVICE_MIMXRT685S || MCUX_HW_DEVICE_RW610 || MCUX_HW_DEVICE_RW612
                    config MCUX_DEPENDENCY_COMPONENT_middleware.mbedtls3x.port.rng_DEPEND_ANYOF_1_OPTION_3
                        bool "ELEMU for KW45/K32W/MCX devices"
                        select MCUX_COMPONENT_middleware.secure-subsystem.elemu
                        select MCUX_COMPONENT_driver.elemu
                        depends on MCUX_HW_DEVICE_KW45B41Z83 || MCUX_HW_DEVICE_K32W1480 || MCUX_HW_DEVICE_MCXW716C || MCUX_HW_DEVICE_MCXW716A || MCUX_HW_DEVICE_KW47B42ZB7 || MCUX_HW_DEVICE_MCXW727C
                endchoice
            endif

        config MCUX_COMPONENT_middleware.mbedtls3x.port.tfm
            bool "TF-M Support"
            select MCUX_COMPONENT_middleware.tfm.ns
            select MCUX_COMPONENT_middleware.mbedtls3x.no_psa
            select MCUX_COMPONENT_middleware.mbedtls3x.port.config
    endmenu

    menu "Crypto Storage Options"
        config MCUX_COMPONENT_middleware.mbedtls3x.crypto_storage_default
            bool "Default"
            select MCUX_COMPONENT_middleware.mbedtls3x.crypto

        config MCUX_COMPONENT_middleware.mbedtls3x.crypto_storage_fatfs
            bool "FatFS"
            select MCUX_COMPONENT_middleware.mbedtls3x.crypto
            select MCUX_COMPONENT_driver.usdhc
            select MCUX_COMPONENT_component.rgpio_adapter
            select MCUX_COMPONENT_middleware.sdmmc.host.usdhc
            select MCUX_COMPONENT_middleware.sdmmc.host.usdhc.non_blocking
            select MCUX_COMPONENT_middleware.sdmmc.sd
            select MCUX_COMPONENT_middleware.fatfs.sd
            select MCUX_COMPONENT_middleware.fatfs

        config MCUX_COMPONENT_middleware.mbedtls3x.crypto_storage_ram
            bool "RAM"
            select MCUX_COMPONENT_middleware.mbedtls3x.crypto
    endmenu

endmenu
```
